## boards/mikroe/mcu_card_4/board.yml
```yaml
board:
  name: mcu_card_4
  full_name: MIKROE MCU Card 4
  vendor: mikroe
  socs:
    - name: stm32f429xx
```

## boards/mikroe/mcu_card_4/dts/bindings/mikroe,board-init.yaml
```yaml
# Copyright (C) 2025 Mario Paja
# SPDX-License-Identifier: Apache-2.0

description: MCU Card 4 for STM32

compatible: "mikroe,board-init"

include: "pinctrl-device.yaml"

properties:
  
  usb-psw-gpios:
    type: phandle-array
    required: true
    description: |
      GPIOs for USB power switch control.
      LOW logic level (0) : USB HOST
      HIGH logic level (1): USB DEVICE

  usb-id-gpios:
    type: phandle-array
    required: true
    description: |
      USB ID pin is used to detect the type of the device attached to the USB port
      LOW logic level (0) : USB HOST
      HIGH logic level (1): USB DEVICE
```

## boards/mikroe/mcu_card_4/mcu_card_4_stm32f429xx_defconfig
```kconfig
# SPDX-License-Identifier: Apache-2.0

# Enable MPU
CONFIG_ARM_MPU=y

# Enable HW stack protection
CONFIG_HW_STACK_PROTECTION=y

CONFIG_SERIAL=y
CONFIG_CONSOLE=y
CONFIG_UART_CONSOLE=y
CONFIG_STDOUT_CONSOLE=y
CONFIG_UART_LINE_CTRL=y

CONFIG_USB_DEVICE_STACK_NEXT=y
CONFIG_CDC_ACM_SERIAL_INITIALIZE_AT_BOOT=y
CONFIG_CDC_ACM_SERIAL_PID=0x0004
CONFIG_CDC_ACM_SERIAL_PRODUCT_STRING="USBD MCU Card 4 for STM32"

CONFIG_USBD_LOG_LEVEL_OFF=y

# enable GPIO
CONFIG_GPIO=y
```

## boards/mikroe/mcu_card_4_stm32/Kconfig.defconfig
```kconfig
# Copyright (c) 2025 Mario Paja
# SPDX-License-Identifier: Apache-2.0

if BOARD_MCU_CARD_4_STM32

if NETWORKING

config NET_L2_ETHERNET
	default y

endif # NETWORKING

endif # BOARD_MCU_CARD_4_STM32
```

## boards/mikroe/mcu_card_4_stm32/Kconfig.mcu_card_4_stm32
```kconfig
# Copyright (c) 2025 Mario Paja
# SPDX-License-Identifier: Apache-2.0

config BOARD_MCU_CARD_4_STM32
	select SOC_STM32F429XX
```

## boards/mikroe/mcu_card_4_stm32/board.yml
```yaml
board:
  name: mcu_card_4_stm32
  full_name: MIKROE MCU Card 4 for STM32
  vendor: mikroe
  socs:
    - name: stm32f429xx
```

## boards/mikroe/uni_clicker/Kconfig.defconfig
```kconfig
# Copyright (c) 2025 Mario Paja
# SPDX-License-Identifier: Apache-2.0

if BOARD_UNI_CLICKER

if NETWORKING

config NET_L2_ETHERNET
	default y

endif # NETWORKING

endif # BOARD_UNI_CLICKER
```

## boards/mikroe/uni_clicker/board.yml
```yaml
board:
  name: uni_clicker
  full_name: MIKROE UNI Clicker
  vendor: mikroe
  socs:
    - name: stm32f429xx
      variants:
        - name: mcu_card_4
```

## boards/mikroe/uni_clicker/dts/bindings/mikroe-mcu-card.yaml
```yaml
# Copyright (C) 2025 Mario Paja
# SPDX-License-Identifier: Apache-2.0

description: |
    GPIO pins exposed on Mikroe MCU Card Connectors.

compatible: "mikroe-mcu-card"

include: [gpio-nexus.yaml, base.yaml]
```
